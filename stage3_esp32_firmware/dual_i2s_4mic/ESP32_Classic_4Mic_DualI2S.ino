/*
  EXPERIMENTAL: Four INMP441 microphones on classic ESP32-WROOM-32.

  I2S0 = MASTER RX, pair A (GPIO19 data)
  I2S1 = SLAVE RX, pair B (GPIO23 data)
  Both pairs share the clocks generated by I2S0. The I2S1 slave clocks
  are fed through two physical loopback wires from the I2S0 clock pins.

  This is a hardware experiment, NOT a claim that the two DMA streams are
  already sample-aligned. Verify alignment with a common acoustic calibration
  source before using the output for physical 2D localization.
*/
#include <Arduino.h>
#include <driver/i2s.h>
#include <esp_err.h>

#define SERIAL_BAUD 921600
#define SAMPLE_RATE 44100
#define CAPTURE_MS 200
#define FRAMES ((SAMPLE_RATE * CAPTURE_MS) / 1000) // 8820
#define CHUNK_FRAMES 128

// Pair A / I2S0 MASTER
#define I2S0_BCLK 22
#define I2S0_WS   21
#define I2S0_SD   19
// Pair B / I2S1 SLAVE. Physical loopbacks: GPIO22->GPIO18, GPIO21->GPIO5
#define I2S1_BCLK_IN 18
#define I2S1_WS_IN   5
#define I2S1_SD      23

struct __attribute__((packed)) FourMicFrame {
  int16_t mic[4]; // M0=pairA-left, M1=pairA-right, M2=pairB-left, M3=pairB-right
};

static FourMicFrame captureBuffer[FRAMES]; // 70,560 bytes
static int32_t rx0[CHUNK_FRAMES * 2];
static int32_t rx1[CHUNK_FRAMES * 2];
static QueueHandle_t i2s0EventQueue = nullptr;
static QueueHandle_t i2s1EventQueue = nullptr;
static uint32_t i2s0RxQueueOverflows = 0;
static uint32_t i2s1RxQueueOverflows = 0;
static uint32_t i2s0DmaErrors = 0;
static uint32_t i2s1DmaErrors = 0;

static void poll_i2s_events() {
  i2s_event_t ev;
  while (i2s0EventQueue && xQueueReceive(i2s0EventQueue, &ev, 0) == pdTRUE) {
    if (ev.type == I2S_EVENT_RX_Q_OVF) i2s0RxQueueOverflows++;
    if (ev.type == I2S_EVENT_DMA_ERROR) i2s0DmaErrors++;
  }
  while (i2s1EventQueue && xQueueReceive(i2s1EventQueue, &ev, 0) == pdTRUE) {
    if (ev.type == I2S_EVENT_RX_Q_OVF) i2s1RxQueueOverflows++;
    if (ev.type == I2S_EVENT_DMA_ERROR) i2s1DmaErrors++;
  }
}

static bool install_i2s_pair() {
  i2s_config_t cfg = {
    .mode = (i2s_mode_t)(I2S_MODE_SLAVE | I2S_MODE_RX),
    .sample_rate = SAMPLE_RATE,
    .bits_per_sample = I2S_BITS_PER_SAMPLE_32BIT,
    .channel_format = I2S_CHANNEL_FMT_RIGHT_LEFT,
    .communication_format = I2S_COMM_FORMAT_STAND_I2S,
    .intr_alloc_flags = ESP_INTR_FLAG_LEVEL1,
    .dma_buf_count = 8,
    .dma_buf_len = 256,
    .use_apll = false,
    .tx_desc_auto_clear = false,
    .fixed_mclk = 0
  };
  i2s_pin_config_t pins = {
    .bck_io_num = I2S1_BCLK_IN,
    .ws_io_num = I2S1_WS_IN,
    .data_out_num = I2S_PIN_NO_CHANGE,
    .data_in_num = I2S1_SD
  };
  esp_err_t e = i2s_driver_install(I2S_NUM_1, &cfg, 8, &i2s1EventQueue);
  if (e != ESP_OK) { Serial.printf("ERR I2S1 install: %s\n", esp_err_to_name(e)); return false; }
  e = i2s_set_pin(I2S_NUM_1, &pins);
  if (e != ESP_OK) { Serial.printf("ERR I2S1 pins: %s\n", esp_err_to_name(e)); return false; }

  cfg.mode = (i2s_mode_t)(I2S_MODE_MASTER | I2S_MODE_RX);
  pins.bck_io_num = I2S0_BCLK;
  pins.ws_io_num = I2S0_WS;
  pins.data_in_num = I2S0_SD;
  e = i2s_driver_install(I2S_NUM_0, &cfg, 8, &i2s0EventQueue);
  if (e != ESP_OK) { Serial.printf("ERR I2S0 install: %s\n", esp_err_to_name(e)); return false; }
  e = i2s_set_pin(I2S_NUM_0, &pins);
  if (e != ESP_OK) { Serial.printf("ERR I2S0 pins: %s\n", esp_err_to_name(e)); return false; }

  // Start the slave receiver first; then start the master that supplies BCLK/WS.
  e = i2s_start(I2S_NUM_1);
  if (e != ESP_OK && e != ESP_ERR_INVALID_STATE) { Serial.printf("ERR I2S1 start: %s\n", esp_err_to_name(e)); return false; }
  e = i2s_start(I2S_NUM_0);
  if (e != ESP_OK && e != ESP_ERR_INVALID_STATE) { Serial.printf("ERR I2S0 start: %s\n", esp_err_to_name(e)); return false; }
  return true;
}

static bool read_exact_frames(i2s_port_t port, int32_t *dst, size_t frames) {
  const size_t targetBytes = frames * 2 * sizeof(int32_t); // stereo slots, 32 bit each
  size_t total = 0;
  while (total < targetBytes) {
    size_t got = 0;
    esp_err_t e = i2s_read(port, ((uint8_t*)dst) + total, targetBytes - total, &got, pdMS_TO_TICKS(150));
    if (e != ESP_OK || got == 0) {
      Serial.printf("ERR I2S read port=%d err=%s bytes=%u/%u\n", (int)port,
                    esp_err_to_name(e), (unsigned)total, (unsigned)targetBytes);
      return false;
    }
    if ((got % 8) != 0) {
      Serial.printf("ERR I2S returned non-frame-aligned byte count: %u\n", (unsigned)got);
      return false;
    }
    total += got;
  }
  poll_i2s_events();
  return true;
}

static bool flush_both_ports() {
  // Drain an equal number of frames from both streams after clocks are running.
  // 8 x 256 frames equals the configured 8 x 256-frame DMA ring depth.
  static int32_t discard0[256 * 2];
  static int32_t discard1[256 * 2];
  for (int k = 0; k < 8; ++k) {
    if (!read_exact_frames(I2S_NUM_0, discard0, 256)) return false;
    if (!read_exact_frames(I2S_NUM_1, discard1, 256)) return false;
  }
  return true;
}

static inline int16_t unpack_inmp441(int32_t word) {
  // INMP441 24-bit two's-complement data is MSB-aligned in the 32-bit I2S slot.
  // Keep the upper 16 bits for compact PCM transfer.
  return (int16_t)(word >> 16);
}

static void capture_and_send() {
  Serial.println("[4MIC] warming both I2S receivers...");
  delay(120);
  if (!flush_both_ports()) {
    Serial.println("ERR DMA flush failed; no capture sent.");
    return;
  }

  i2s0RxQueueOverflows = i2s1RxQueueOverflows = 0;
  i2s0DmaErrors = i2s1DmaErrors = 0;
  size_t totalFrames = 0;
  while (totalFrames < FRAMES) {
    size_t n = min((size_t)CHUNK_FRAMES, (size_t)FRAMES - totalFrames);
    if (!read_exact_frames(I2S_NUM_0, rx0, n)) return;
    if (!read_exact_frames(I2S_NUM_1, rx1, n)) return;
    for (size_t i = 0; i < n; ++i) {
      captureBuffer[totalFrames + i].mic[0] = unpack_inmp441(rx0[2*i]);
      captureBuffer[totalFrames + i].mic[1] = unpack_inmp441(rx0[2*i + 1]);
      captureBuffer[totalFrames + i].mic[2] = unpack_inmp441(rx1[2*i]);
      captureBuffer[totalFrames + i].mic[3] = unpack_inmp441(rx1[2*i + 1]);
    }
    totalFrames += n;
  }

  // Serial protocol: ASCII header, exact binary payload, ASCII end marker.
  poll_i2s_events();
  Serial.printf("M4_BEGIN,1,%d,%u,4,16,DUAL_I2S_SHARED_CLOCK_UNCALIBRATED,OVF0=%u,OVF1=%u,DMA0=%u,DMA1=%u\n",
                SAMPLE_RATE, (unsigned)FRAMES,
                (unsigned)i2s0RxQueueOverflows, (unsigned)i2s1RxQueueOverflows,
                (unsigned)i2s0DmaErrors, (unsigned)i2s1DmaErrors);
  Serial.flush();
  const size_t bytes = sizeof(captureBuffer);
  size_t sent = 0;
  const uint8_t *p = (const uint8_t*)captureBuffer;
  while (sent < bytes) {
    size_t n = Serial.write(p + sent, min((size_t)4096, bytes - sent));
    if (n == 0) { Serial.println("\nERR UART write stalled"); return; }
    sent += n;
  }
  Serial.flush();
  Serial.print("\nM4_END\n");
  Serial.flush();
  Serial.printf("[4MIC] sent %u bytes; RX queue overflows I2S0=%u I2S1=%u; DMA errors I2S0=%u I2S1=%u.\n",
                (unsigned)sent, (unsigned)i2s0RxQueueOverflows, (unsigned)i2s1RxQueueOverflows,
                (unsigned)i2s0DmaErrors, (unsigned)i2s1DmaErrors);
  Serial.println("[4MIC] pair-A=GPIO19, pair-B=GPIO23; cross-I2S sample alignment still requires calibration.");
}

void setup() {
  Serial.begin(SERIAL_BAUD);
  delay(800);
  Serial.println("\nCLASSIC_ESP32_4MIC_DUAL_I2S_EXPERIMENTAL");
  Serial.printf("Free heap before I2S: %u\n", (unsigned)ESP.getFreeHeap());
  if (!install_i2s_pair()) {
    Serial.println("FATAL: dual-I2S installation failed. Check Arduino-ESP32 core and pin wiring.");
    while (true) delay(1000);
  }
  Serial.printf("READY_4MIC,fs=%d,frames=%u,baud=%d\n", SAMPLE_RATE, (unsigned)FRAMES, SERIAL_BAUD);
  Serial.println("Send C to capture one 200 ms four-channel burst.");
  Serial.println("WARNING: I2S1 clock loopbacks GPIO22->GPIO18 and GPIO21->GPIO5 are required.");
}

void loop() {
  while (Serial.available()) {
    char c = (char)Serial.read();
    if (c == '?' ) {
      Serial.printf("READY_4MIC,fs=%d,frames=%u,channels=4,baud=%d\n", SAMPLE_RATE, (unsigned)FRAMES, SERIAL_BAUD);
    } else if (c == 'C' || c == 'c') {
      capture_and_send();
    }
  }
  delay(2);
}
